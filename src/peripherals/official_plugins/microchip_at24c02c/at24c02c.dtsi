/*
 * Microchip AT24C02C I2C EEPROM Device Tree Include
 * Vendor: Microchip Technology / Atmel
 */
#ifndef FBB_I2C_BUS
#define FBB_I2C_BUS i2c0
#endif

&FBB_I2C_BUS {
    eeprom@50 {
        compatible = "atmel,24c02";
        reg = <0x50>;
    };
};
