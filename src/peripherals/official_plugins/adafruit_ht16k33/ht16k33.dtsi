/*
 * Adafruit 0.56" 4-Digit 7-Segment HT16K33 I2C Display Device Tree Include
 * Vendor: Adafruit / Holtek
 * Default Slave Address: 0x70
 */
#ifndef FBB_I2C_BUS
#define FBB_I2C_BUS i2c0
#endif

&FBB_I2C_BUS {
    seg7_0: seg7@70 {
        compatible = "adafruit,ht16k33-red", "holtek,ht16k33";
        reg = <0x70>;
    };
};
