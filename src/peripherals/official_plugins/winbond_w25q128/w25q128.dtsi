/*
 * Winbond W25Q128 SPI Flash Device Tree Include
 * Vendor: Winbond
 */
#ifndef FBB_SPI_BUS
#define FBB_SPI_BUS spi0
#endif

&FBB_SPI_BUS {
    flash0: flash@0 {
        compatible = "winbond,w25q128";
        reg = <0>;
        spi-max-frequency = <104000000>;
    };
};
