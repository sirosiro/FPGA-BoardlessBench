/*
 * Solomon Systech SSD1306 I2C OLED Display Device Tree Include
 * Vendor: Solomon Systech
 */
#ifndef FBB_I2C_BUS
#define FBB_I2C_BUS i2c0
#endif

&FBB_I2C_BUS {
    oled0: oled@3c {
        compatible = "solomon,ssd1306";
        reg = <0x3c>;
        fbb,shm-path = "/dev/shm/fbb_display_0";
    };
};
