/dts-v1/;

#include "src/peripherals/official_plugins/winbond_w25q128/w25q128.dtsi"
#include "src/peripherals/official_plugins/microchip_mcp3208/mcp3208.dtsi"

/ {
    /* 
     * 【解説: SPIバス0の定義】
     * ベースアドレス 0xe0006000 にある Zynq SPI コントローラを定義します。
     * スレーブデバイス (flash@0, adc@1) はベンダー提供の .dtsi を #include して配置します。
     */
    spi0: spi@e0006000 {
        compatible = "xlnx,zynq-spi-1.0";
        reg = <0xe0006000 0x1000>;
        bus_id = <0>;
        label = "/dev/spidev0";
    };

    uart2: serial@e0001000 {
        compatible = "xlnx,xuartps";
        reg = <0xe0001000 0x1000>;
        label = "/dev/ttyPS1";
    };

    adc_regs: uio@40000000 {
        compatible = "generic-uio";
        reg = <0x40000000 0x1000>;
        label = "/dev/uio0";

    };
};
