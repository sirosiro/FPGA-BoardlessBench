/dts-v1/;

/ {
    #address-cells = <1>;
    #size-cells = <1>;
    model = "zynq-vfpga-P02-robot-amr";
    compatible = "xlnx,zynq-7000";

    /*
     * 【Scenario P02: ros2_control Autonomous Mobile Robot (AMR) UIO Node】
     * Real-world standard Linux UIO (/dev/uio0) actuator/sensor node.
     * Maps dual-wheel motor PWM, quadrature encoder pulse counters,
     * 1kHz hardware periodic timer interrupt, and E-STOP controls.
     */
    vfpga_robot_uio: vfpga_robot_uio@40000000 {
        compatible = "generic-uio";
        reg = <0x40000000 0x1000>;
        label = "/dev/uio0";
        interrupts = <7>;
        status = "okay";


    };
};
