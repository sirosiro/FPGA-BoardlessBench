/dts-v1/;

/ {
    vfpga_reg: vfpga_reg@40000000 {
        compatible = "generic-uio";
        reg = <0x40000000 0x1000>; // 4KB

    };

    uart2: serial@e0001000 {
        compatible = "xlnx,xuartps";
        reg = <0xe0001000 0x1000>;
        label = "/dev/ttyPS1";
    };
};
