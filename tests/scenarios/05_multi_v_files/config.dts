/dts-v1/;
/ {
    #address-cells = <1>;
    #size-cells = <1>;

    /* 
     * 【解説: 仮想FPGAデバイスの定義】
     * 複数ファイル構成の Verilog ロジックを検証するためのデバイスを定義します。
     */
    my_dev: my_dev@40000000 {
        compatible = "generic-uio";
        /* 【解説】 物理アドレス 0x40000000 に 4KB (0x1000) の領域を割り当てます */
        reg = <0x40000000 0x1000>;
        /* 【解説】 アプリケーションがこのデバイスを識別するためのラベル */
        label = "MY_MULTI_V_DEV";
        /* 
         * 【解説: レジスタマップ】
         * シミュレータが同期・監視するアドレスを定義します。
         * REG0 (0x0): サブモジュールへの入力値
         * REG1 (0x4): サブモジュールからの演算結果
         */

    };
};
