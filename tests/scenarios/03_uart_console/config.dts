/dts-v1/;

/ {
    /* 
     * 【解説: UARTコントローラの定義】
     * ベースアドレス 0xe0001000 にある Zynq PS UART1 コントローラを定義します。
     * F-BB はこの定義を元に、入出力をホストの PTY へリダイレクトします。
     */
    uart2: serial@e0001000 {
        /* 【解説】 Zynq PS UART 互換であることを示します */
        compatible = "xlnx,xuartps";
        reg = <0xe0001000 0x1000>;
        /* 【解説】 Linuxから見えるデバイスファイル名 (/dev/ttyPS1) */
        label = "/dev/ttyPS1";
    };
};
