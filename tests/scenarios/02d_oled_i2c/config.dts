/dts-v1/;

#include "src/peripherals/official_plugins/solomon_ssd1306/ssd1306.dtsi"

/ {
    /* 
     * 【解説: I2Cバス0の定義】
     * ベースアドレス 0xe0004000 にある Cadence I2C コントローラを定義します。
     */
    i2c1: i2c@e0004000 {
        compatible = "cdns,i2c-r1p10";
        reg = <0xe0004000 0x1000>;
        bus_id = <0>;
        label = "/dev/i2c-0";
    };
};
