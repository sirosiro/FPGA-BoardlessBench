/dts-v1/;

/ {
    /* 
     * 【解説: /dev/mem インターセプト用の定義】
     * F-BB のシミュレータは、この DTS を見て「どの物理アドレス範囲」を
     * エミュレーション（インターセプト）の対象にするかを判断します。
     */
    vfpga_reg: vfpga_reg@40000000 {
        /* 
         * 【解説】 
         * ここでは UIO と同じ compatible を指定していますが、これはエミュレータに対して
         * 「この領域はメモリマップドI/Oとして振る舞う」と教えるための共通の目印です。
         */
        compatible = "generic-uio";
        
        /* 【解説】 物理ベースアドレス(0x40000000)とサイズ(4KB)を定義します */
        reg = <0x40000000 0x1000>;
        
        /* 
         * 【解説: レジスタマップ定義】
         * この定義を元に、Verilator用のRTL (vfpga_top.v) のスケルトンが生成されます。
         * /dev/mem 経由でアクセスした際も、このオフセットに従ってRTL内のレジスタが叩かれます。
         */

    };
};
