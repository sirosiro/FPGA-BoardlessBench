/dts-v1/;
/ {
    compatible = "fsl,imx8mp-evk", "fsl,imx8mp";
    model = "NXP i.MX8MPlus EVK board";
    /* 
     * i.MX8MP GPIO1
     * Base physical address: 0x30200000, Size: 0x1000
     */
    gpio1: gpio@30200000 {
        compatible = "fsl,imx8mp-gpio";
        reg = <0x30200000 0x1000>;
        label = "/dev/uio0";
        registers = 
            "DR(DATA) @ 0x00",
            "GDIR(INV_TRI) @ 0x04";
    };

    /* 
     * i.MX8MP UART1
     * Base physical address: 0x30860000, Size: 0x1000
     */
    uart1: serial@30860000 {
        compatible = "fsl,imx8mp-uart";
        reg = <0x30860000 0x1000>;
        label = "/dev/ttymxc0";
    };
};
