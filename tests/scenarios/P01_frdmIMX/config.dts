/dts-v1/;
/ {
    compatible = "fsl,imx95-15x15-frdm", "fsl,imx95";
    model = "NXP i.MX95 15X15 FRDM board";
    /* 
     * i.MX95 GPIO1 (AON Domain)
     * Base physical address: 0x47400000, Size: 0x1000
     */
    gpio1: gpio@47400000 {
        compatible = "fsl,imx95-gpio";
        reg = <0x47400000 0x1000>;
        label = "/dev/uio0";
        registers = 
            "PDOR(DATA) @ 0x00",
            "PDIR(DATA) @ 0x04",
            "PDDR(INV_TRI) @ 0x08";
    };

    /* 
     * i.MX95 LPUART1
     * Base physical address: 0x44380000, Size: 0x1000
     */
    lpuart1: serial@44380000 {
        compatible = "fsl,imx95-lpuart";
        reg = <0x44380000 0x1000>;
        label = "/dev/ttyLP0";
    };
};
