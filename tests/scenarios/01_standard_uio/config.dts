/dts-v1/;

/ {
    /*
     * 【解説: UIOデバイスの定義】
     * Linux カーネル標準の Device Tree 構文に準拠し、物理アドレス・サイズ・互換ドライバを定義します。
     * 本ファイルは実機 Linux / PetaLinux / Vivado にそのまま流用可能です。
     */
    vfpga_reg: vfpga_reg@40000000 {
        compatible = "generic-uio";
        reg = <0x40000000 0x1000>;
        label = "/dev/uio0";
        status = "okay";
    };
};
